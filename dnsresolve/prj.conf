## CMakeLists.txt
```
cmake_minimum_required(VERSION 3.13.1)

set(common_dir ${CMAKE_CURRENT_SOURCE_DIR}/../common)
set(common_src_dir ${common_dir}/src)
set(common_include_dir ${common_dir}/include)

include_directories(
	${common_include_dir}
)

find_package(Zephyr REQUIRED HINTS $ENV{ZEPHYR_BASE})

project(dns_resolve)

target_sources(app PRIVATE
	src/main.c
	${common_src_dir}/libc_extensions.c
)

set(gen_dir ${ZEPHYR_BINARY_DIR}/include/generated/)

include(${ZEPHYR_BASE}/samples/net/common/common.cmake)

add_subdirectory(src/net/)
```

## prj.conf
```kconfig
# General config
CONFIG_NET_TCP_ISN_RFC6528=n

# pthreads
CONFIG_POSIX_API=y
CONFIG_PTHREAD_IPC=y
CONFIG_POSIX_MQUEUE=y

# networking
CONFIG_NETWORKING=y
CONFIG_NET_IPV4=y
CONFIG_NET_TCP=y
CONFIG_NET_SOCKETS=y
CONFIG_NET_SOCKETS_POSIX_NAMES=y
CONFIG_SNTP=y
CONFIG_NET_SOCKETS_POLL_MAX=4
CONFIG_MINIMAL_LIBC_MALLOC_ARENA_SIZE=16384
CONFIG_NET_TX_STACK_SIZE=2048
CONFIG_NET_RX_STACK_SIZE=2048
CONFIG_ISR_STACK_SIZE=2048
CONFIG_MAIN_STACK_SIZE=8192
CONFIG_IDLE_STACK_SIZE=1024

CONFIG_NET_MAX_CONN=5

CONFIG_NET_CONFIG_SETTINGS=y
CONFIG_NET_DHCPV4=y

CONFIG_NET_SHELL=y

# Network driver config
CONFIG_TEST_RANDOM_GENERATOR=y

# logging
CONFIG_NET_LOG=y
CONFIG_LOG_STRDUP_BUF_COUNT=16

CONFIG_NET_SOCKETS_SOCKOPT_TLS=n

# Enable the DNS resolver
CONFIG_DNS_RESOLVER=y

# Enable additional buffers
CONFIG_DNS_RESOLVER_ADDITIONAL_BUF_CTR=5
# Enable additional queries
CONFIG_DNS_RESOLVER_ADDITIONAL_QUERIES=2

CONFIG_DNS_RESOLVER_MAX_SERVERS=2
CONFIG_DNS_SERVER_IP_ADDRESSES=y
CONFIG_DNS_NUM_CONCUR_QUERIES=5

# Google DNS IPv4 and IPv6 servers
CONFIG_DNS_SERVER1="8.8.8.8"

CONFIG_DEBUG=y
#CONFIG_NO_OPTIMIZATIONS=y
```

## qemuOverlayConf.conf
```kconfig
CONFIG_NET_L2_ETHERNET=y
CONFIG_NET_QEMU_ETHERNET=y

CONFIG_ETH_E1000=y

CONFIG_PCIE=y

#CONFIG_ETHERNET_LOG_LEVEL_DBG=y

CONFIG_FPU=y

CONFIG_MAIN_STACK_SIZE=4096

CONFIG_NET_DHCPV4=n
CONFIG_NET_CONFIG_MY_IPV4_ADDR="192.0.2.1"
CONFIG_NET_CONFIG_MY_IPV4_NETMASK="255.255.255.0"
CONFIG_NET_CONFIG_MY_IPV4_GW="192.0.2.2"
CONFIG_NET_CONFIG_PEER_IPV4_ADDR="192.0.2.2"
```

## src/main.c
```c
//=================================================================================================
// Includes:                  List of required include files.
//=================================================================================================
#include <zephyr.h>
#include <sys/printk.h>
#include <logging/log.h>
#include <net/net_ip.h>
#include <stdio.h>
#include "../include/net/dns.h"

//=================================================================================================
// Defines/Macros:            Definition of local macros.
//=================================================================================================
LOG_MODULE_REGISTER(dns_resolve_main, LOG_LEVEL_DBG);

//=================================================================================================
// Variables:                 Definition of local variables & constants.
//=================================================================================================
struct k_delayed_work dns_resolve_work;


static int retrieveUrl(const char *url, char *address, size_t addressLen) {
    struct sockaddr_in sa;

    int err = dns_resolve_one(url, &sa);
    LOG_INF("DNS resolve result: %d", err);

    if (err != 0) {
        LOG_WRN("Failed to retrieve IP address of %s. Error: %d", url, err);
        return err;
    }

    uint8_t *ip = (sa).sin_addr.s4_addr;

    LOG_INF("IP of %s is %d.%d.%d.%d", url, ip[0], ip[1], ip[2], ip[3]);

    address[addressLen - 1] = 0;
    snprintf(address, addressLen, "%d.%d.%d.%d", ip[0], ip[1], ip[2], ip[3]);

    LOG_INF("IP of %s is %s", url, address);

    if (zsock_inet_ntop(AF_INET, &sa.sin_addr, address, addressLen) != NULL) {
        LOG_INF("IP address of %s is %s", url, address);
    }

    return 0;
}

static void run_request(struct k_work *work) {
    ARG_UNUSED(work);
    const char* url = "www.zephyrproject.org";
    char addr[NET_IPV6_ADDR_LEN];
    int ret = retrieveUrl(url, addr, NET_IPV6_ADDR_LEN);
    if(ret == 0) {
        LOG_INF("IP of %s is %s", url, addr);
    }
    else {
        LOG_WRN("dns resolve failed with code %d", ret);
    }
}

//*************************************************************************************************
// main:        main-thread / main-function

void main(void) {

    dns_init();
    k_delayed_work_init(&dns_resolve_work, run_request);
    k_delayed_work_submit(&dns_resolve_work, K_SECONDS(1));
}
```

## include/utils.h
```c
/**
 *  This header just defines some useful macros.
 * */

#ifndef _UTILS_H_
#define _UTILS_H_

#include <zephyr.h>

#define CRC_INIT	0xffffffff
#define CRC_POLY	0x04c11db7

#define REQUIRE_MODULE_STATE(state, state_name, req, req_name)                  \
    if ((req) != (state)) {                                                     \
        LOG_ERR("[%s] Invalid operation in state <%s> (required <%s>)",         \
                __func__, state_name, req_name);                                \
        return -EACCES;                                                         \
    }

#define REQUIRE(e, r)                                                           \
    if (!(e)) {                                                                 \
        LOG_ERR("[%s] Required (%s) which was not the case.", __func__, #e);    \
        return r;                                                               \
    }

#define IS_DIGIT(d) ('0' <= (d) && (d) <= '9')

/**
 *  @brief  This structure contains all the item information for a FIFO queue element.
*/
struct fifo_meta {
    void        *fifo_reserved; //< Used by Zephyr's FIFO implementation.
    atomic_t    is_used;        //< Flag indicating whether the item has been processed.
};

/**
 *  @brief  Calculates an MPEG2 CRC for a given buffer.
 * 
 *  @param  data    Data over which the CRC is to be calculated.
 *  @param  len     Length of the data buffer in bytes.
*/
static inline  uint32_t crc_mpeg2(const uint8_t * data, const uint16_t len) {
    uint32_t crc = CRC_INIT;
	for (uint16_t i = 0; i < len; i++) {
		crc ^= (((const uint32_t) data[i]) << 24);
		for (uint16_t j = 0; j < 8; j++) {
            uint32_t msb = crc >> 31;
			crc <<= 1;
			crc ^= (0 - msb) & CRC_POLY;
		}
	}
	return crc;
}

/**
 *  @brief  Checks whether a FIFO item is currently in use.
 * 
 *  @param  item    FIFO item to be checked. The item MUST have a struct fifo_meta as first member.
 * 
 *  @return True if the value is currently in use, false otherwise.
*/
static inline bool fifo_meta_in_use(void *item) {
    return atomic_get(&((struct fifo_meta *) item)->is_used) != 0;
}


/**
 *  @brief  Marks a FIFO item as being used.
 * 
 *  @param  item    FIFO item to be checked. The item MUST have a struct fifo_meta as first member.
 * 
 *  @return True if the operation was successful - false otherwise.
*/
static inline bool fifo_meta_mark_in_use(void *item) {
    return atomic_cas(&((struct fifo_meta *) item)->is_used, 0, 1);
}


/**
 *  @brief  Marks a FIFO item as being free.
 * 
 *  @param  item    FIFO item to be checked. The item MUST have a struct fifo_meta as first member.
*/
static inline void fifo_meta_mark_free(void *item) {
    atomic_clear(&((struct fifo_meta *) item)->is_used);
}

#endif
```
